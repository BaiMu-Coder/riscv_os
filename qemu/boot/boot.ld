/*---------------------------------------------------------链接脚本的意义---------------------------------------------------------------------*/
/* 链接脚本把 lowlevel 固件的运行地址设为 0x20000000，因此链接器在处理代码段、符号和地址引用时，都是以 0x20000000 为基址进行布局。
运行时，QEMU 又将 pflash 映射到同样的物理地址 0x20000000，并把 fw.bin 作为这块 flash 的内容来源。
这样，代码的链接地址和实际执行地址保持一致，因此跳转、取地址和符号引用都不会发生错乱。 */


OUTPUT_ARCH( "riscv" )  /*输出可执行文件平台*/

ENTRY( _start )         /*程序入口函数*/

MEMORY                  /*定义内存域,供后面的SECTIONS去放内容*/
{ 
    /*定义名为flash的内存域属性以及起始地址，大小等*/
    /*flash是一个名字，不是关键字   (rxai!w)描述属性：这是一块r可读、x可执行、a可分配、i已初始化、!w但不可写的区域*/
    flash (rxai!w) : ORIGIN = 0x20000000, LENGTH = 512k 
}

SECTIONS                /*定义段域*/
{
  .text :               /*.text段域*/
  {
    KEEP(*(.text))      /*将所有.text段链接在此域内，keep是保持防止优化，即无论如何都保留此段*/
  } >flash              /*这里的意思就是 把这个段放到flash这块内存里面*/
}